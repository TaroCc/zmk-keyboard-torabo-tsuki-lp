&pointing_listener {
    status = "okay";
    device = <&pointing_device>;
    // トラックボールの上下左右を反転。その後、動かすと layer 1 (マウスレイヤー)
    // を自動で有効化 (動きが止まって 500ms で解除)。
    input-processors = <&zip_xy_transform (INPUT_TRANSFORM_X_INVERT | INPUT_TRANSFORM_Y_INVERT)>,
                        <&zip_temp_layer 1 500>;

    // layer 4 (左親指 &mo 4 長押し) を有効化中はトラックボールでスクロール (同じく反転)。
    scroller {
        layers = <4>;
        input-processors = <&zip_xy_transform (INPUT_TRANSFORM_X_INVERT | INPUT_TRANSFORM_Y_INVERT)>,
                           <&zip_xy_to_scroll_mapper>;
    };
};
